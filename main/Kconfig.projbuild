## main/Kconfig.projbuild
```kconfig
menu "Remote OTA (WiFi)"

    config OTA_WIFI_SSID
        string "WiFi SSID"
        default "CU_s6PR"
        help
            设备连接的路由器 SSID（局域网 OTA 用）

    config OTA_WIFI_PASSWORD
        string "WiFi Password"
        default ""
        help
            WiFi 密码

    config OTA_DEVICE_NAME_PREFIX
        string "Device name prefix"
        default "MaiQing-C3"
        help
            设备名前缀，完整名为 前缀-SN后6位，同时用于 mDNS 主机名

    config OTA_HTTP_PORT
        int "HTTP server port"
        default 80
        range 80 65535

endmenu

menu "Joystick"

    config JOYSTICK_ENABLE_TEST
        bool "Boot into joystick test (skip WiFi/OTA UI)"
        default n
        help
            上电后仅初始化 LCD 与摇杆，进入测试界面并在串口打印按键事件。
            默认关闭，正常启动为 WiFi/OTA/设备信息界面。
            需要标定时在 menuconfig 中开启，或 sdkconfig 中设置
            CONFIG_JOYSTICK_ENABLE_TEST=y 后重新编译。

endmenu

menu "LED"

    config LED_ENABLE_BLINK
        bool "Enable D4/D5 LED blink test task"
        default n
        help
            D4(GPIO12)、D5(GPIO13)，高电平有效；D4 每 1s、D5 每 2s 翻转。
            默认关闭，正常为设备信息界面。需要时在 menuconfig 开启，或
            sdkconfig 中设置 CONFIG_LED_ENABLE_BLINK=y 后重新编译。
            D5 与摇杆 UP(IO13) 共用，测试 LED 时请关闭摇杆测试。
            详见 docs/LED.md

endmenu
```

## sdkconfig.defaults
```kconfig
# Default target (new projects only; does not overwrite existing sdkconfig)
CONFIG_IDF_TARGET="esp32c3"

# OTA dual app partitions (partitions.csv)
# CONFIG_PARTITION_TABLE_SINGLE_APP is not set
CONFIG_PARTITION_TABLE_CUSTOM=y
CONFIG_PARTITION_TABLE_CUSTOM_FILENAME="partitions.csv"
CONFIG_PARTITION_TABLE_FILENAME="partitions.csv"

# HTTP OTA (esp_http_server enabled via main/CMakeLists.txt)
CONFIG_ESP_HTTPS_OTA_ALLOW_HTTP=y
CONFIG_BOOTLOADER_APP_ROLLBACK_ENABLE=y

# Longer WDT for OTA flash writes
CONFIG_ESP_INT_WDT_TIMEOUT_MS=1000
CONFIG_ESP_TASK_WDT_TIMEOUT_S=30

# mDNS
CONFIG_MDNS_MAX_SERVICES=4

# WiFi: set SSID/password in menuconfig or local sdkconfig (not in git)
CONFIG_OTA_WIFI_SSID=""
CONFIG_OTA_WIFI_PASSWORD=""
CONFIG_OTA_DEVICE_NAME_PREFIX="MaiQing-C3"
CONFIG_OTA_HTTP_PORT=80

# Joystick test off by default; enable in menuconfig when needed
# CONFIG_JOYSTICK_ENABLE_TEST is not set
```
